#include "../non_trackball.overlay"

// 特定のデバイスだけでなく、全てのマウスの動きに強制反応させる
&peripheral_listener {
    status = "okay";
    
    // カーソル移動量を75%にスケールダウン（3/4）
    input-processors = <&zip_xy_scaler 3 4>, <&zip_temp_layer 4 700>;

    scroller {
        layers = <5>;
        // スクロール速度をテスト値(1/100)の2倍に引き上げ（1/50）
        input-processors = 
            <&zip_xy_to_scroll_mapper>,
            <&zip_scroll_scaler 1 50>;
    };
};